## drivers/char/frandom/Kconfig
```kconfig
config FRANDOM
        tristate "FRANDOM support"
        default n
        ---help---
        Frandom is a Linux kernel random number generator,
        which is 10-50 times faster than what you get from Linux'
        built-in urandom. And it uses very little frandom
        and erandom of the kernel's entropy pool,
        so it is very useful for applications that require a
        handy source for lots of random data.
        If unsure, say Y.
```

## gt/Kconfig
```kconfig
config GT_L2_OC
	bool "1.3 ghz L2 Cache Boost Clock"
	default n
	help
	  This will enable L2 cache boost clock.

config GT_CPU_OC
	bool "1.6 ghz CPU Overclock"
	default n
	help
	  This will enable CPU overclocking.
```
